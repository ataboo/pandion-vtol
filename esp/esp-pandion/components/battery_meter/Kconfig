## esp/esp-pandion/components/battery_meter/Kconfig
```kconfig
menu "ADC Volt Meter"
    config VCC_METER_ADC_CHANNEL
        int "VCC Meter ADC Channel"
        range 0 9
        default 0
endmenu
```

## esp/esp-pandion/components/flight_control/Kconfig
```kconfig
menu "Pandion Flight Control"
    menu "GPIO Pins"
        config RWTILT_GPIO
            int "RW Tilt GPIO"
            default 19
            range 1 39

        config RWTRANS_GPIO
            int "RW Transition GPIO"
            default 18
            range 1 39

        config RWPROP_GPIO
            int "RW Propeller GPIO"
            default 17
            range 1 39

        config LWTILT_GPIO
            int "LW Tilt GPIO"
            default 23
            range 1 39

        config LWTRANS_GPIO
            int "LW Transition GPIO"
            default 27
            range 1 39

        config LWPROP_GPIO
            int "LW Propeller GPIO"
            default 26
            range 1 39

        config AFTPROP_GPIO
            int "Aft Propeller GPIO"
            default 25
            range 1 39

        config ELEVATOR_GPIO
            int "Elevator GPIO"
            default 12
            range 1 39

        config RUDDER_GPIO
            int "Rudder GPIO"
            default 14
            range 1 39
    endmenu
endmenu
```

## esp/esp-pandion/components/gyro_control/Kconfig
```kconfig
menu "MPU6050 Gyro"
    config GYRO_SCL
        int "I2C SCL GPIO Pin"
        range 1 39
        default 22
    
    config GYRO_SDA
        int "I2C SDA GPIO Pin"
        range 1 39
        default 21

    config GYRO_I2C_ADDRESS
        hex "I2C Address"
        range 0x68 0x69
        default 0x68

    config GYRO_RANGE
        int "Gyro Range"
        range 0 3
        default 1

    config ACCEL_RANGE
        int "Accelerometer Range"
        range 0 3
        default 1

    config DLPF_CFG_LEVEL
        int "Digital Low Pass Filter Level"
        range 0 7
        default 0

endmenu
```

## esp/esp-pandion/components/ibus_uart/Kconfig
```kconfig
menu "IBus Receiver UART"
    config IBUS_CTRL_UART_NUM
        int "IBus Control UART Number"
        range 0 2
        default 1
    
    config IBUS_CTRL_GPIO
        int "IBus Control GPIO Pin"
        range -1 39
        default 16

    config IBUS_SENSOR_UART_NUM
        int "IBus Sensor UART Number"
        range 0 2
        default 2

    config IBUS_SENSOR_RX_GPIO
        int "IBus Sensor Rx GPIO Pin"
        range -1 39
        default 9

    config IBUS_SENSOR_TX_GPIO
        int "IBus Sensor Tx GPIO Pin"
        range -1 39
        default 9
endmenu
```

## esp/esp-pandion/components/wifi_ap/Kconfig
```kconfig
menu "WIFI AP Config"
    config WIFI_AP_SSID
        string "WiFi AP SSID"
        default "pandion_ap"
    
    config WIFI_AP_PASSWORD
        string "WIFI AP Password"
        default "asdfasdf"

    config WIFI_CHANNEL
        int "WiFi Channel"
        range 1 13
        default 1

    config WIFI_MAX_CONNECTIONS
        int "Max Stations"
        default 4
endmenu
```

## esp/pandion-bus-mixer/components/dshot_esc/Kconfig
```kconfig
menu "D-Shot ESC Control"
    choice DSHOT_RATE
        prompt "D-Shot Rate"
        config DSHOT_RATE600
            bool "600"
        config DSHOT_RATE300
            bool "300"
        config DSHOT_RATE150
            bool "150"
    endchoice
endmenu
```

## esp/pandion-bus-mixer/components/flight_control/Kconfig
```kconfig
menu "Pandion Flight Control"
    menu "GPIO Pins"
        config RWTILT_GPIO
            int "RW Tilt GPIO"
            default 19
            range 1 39

        config RWTRANS_GPIO
            int "RW Transition GPIO"
            default 21
            range 1 39

        config RWPROP_GPIO
            int "RW Propeller GPIO"
            default 22
            range 1 39

        config LWTILT_GPIO
            int "LW Tilt GPIO"
            default 23
            range 1 39

        config LWTRANS_GPIO
            int "LW Transition GPIO"
            default 25
            range 1 39

        config LWPROP_GPIO
            int "LW Propeller GPIO"
            default 26
            range 1 39

        config AFTPROP_GPIO
            int "Aft Propeller GPIO"
            default 27
            range 1 39

        config ELEVATOR_GPIO
            int "Elevator GPIO"
            default 32
            range 1 39

        config RUDDER_GPIO
            int "Rudder GPIO"
            default 33
            range 1 39
    endmenu
    
    menu "PID Values"
        config PID_HORIZ_PX_GAIN
            int  "PID Horizontal X Position Gain"
            default 10
        config PID_HORIZ_IX_GAIN
            int "PID Horizontal X Integral Gain"
            default 0
        config PID_HORIZ_DX_GAIN
            int "PID Horizontal X Derivative Gain"
            default 0

        config PID_HORIZ_PY_GAIN
            int  "PID Horizontal Y Position Gain"
            default 10
        config PID_HORIZ_IY_GAIN
            int "PID Horizontal Y Integral Gain"
            default 0
        config PID_HORIZ_DY_GAIN
            int "PID Horizontal Y Derivative Gain"
            default 0

        config PID_HORIZ_PZ_GAIN
            int  "PID Horizontal Z Position Gain"
            default 10
        config PID_HORIZ_IZ_GAIN
            int "PID Horizontal Z Integral Gain"
            default 0
        config PID_HORIZ_DZ_GAIN
            int "PID Horizontal Z Derivative Gain"
            default 0
        
        config PID_VERT_PX_GAIN
            int  "PID Vertical X Position Gain"
            default 10
        config PID_VERT_IX_GAIN
            int "PID Vertical X Integral Gain"
            default 0
        config PID_VERT_DX_GAIN
            int "PID Vertical X Derivative Gain"
            default 0

        config PID_VERT_PY_GAIN
            int  "PID Vertical Y Position Gain"
            default 10
        config PID_VERT_IY_GAIN
            int "PID Vertical Y Integral Gain"
            default 0
        config PID_VERT_DY_GAIN
            int "PID Vertical Y Derivative Gain"
            default 0

        config PID_VERT_PZ_GAIN
            int  "PID Vertical Z Position Gain"
            default 10
        config PID_VERT_IZ_GAIN
            int "PID Vertical Z Integral Gain"
            default 0
        config PID_VERT_DZ_GAIN
            int "PID Vertical Z Derivative Gain"
            default 0
            
        config MAX_ROLL_RATE
            int "Max roll rate (millideg/sec)"
            default 30000
        config MAX_PITCH_RATE
            int "Max pitch rate (millideg/sec)"
            default 30000
        config MAX_YAW_RATE
            int  "Max yaw rate (millideg/sec)"
            default 30000
    endmenu
endmenu
```

## esp/pandion-bus-mixer/components/ibus_duplex/Kconfig
```kconfig
menu "IBus Duplex"
    config IBUS_UART_RX_NUM
        int "RX UART Number"
        range 0 2
        default 1
    
    config IBUS_UART_RX_GPIO
        int "RX UART GPIO Pin"
        range -1 39
        default -1

    config IBUS_UART_RX_BAUD_RATE
        int "RX UART Baud Rate"
        range 4800 5000000
        default 115200

    config IBUS_UART_SUMCHK_ACTIVE
        bool "Sum-check Active"
        default false

    config IBUS_UART_TX_ACTIVE
        bool "IBus forwarding on"
        help 
            Transmit IBus data received to another UART.
        default false

    config IBUS_UART_TX_NUM
        int "TX UART Number"
        depends on IBUS_UART_TX_ACTIVE
        range 0 2
        default 2

    config IBUS_UART_TX_GPIO
        int "TX UART GPIO Pin"
        depends on IBUS_UART_TX_ACTIVE
        help
            Select the pin to transmit forward IBus data on.
        range -1 39
        default -1

    config IBUS_UART_TX_BAUD_RATE
        int "RX UART Baud Rate"
        depends on IBUS_UART_TX_ACTIVE
        range 4800 5000000
        default 115200
endmenu
```
